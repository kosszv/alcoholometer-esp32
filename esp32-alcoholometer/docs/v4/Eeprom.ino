//Функция записи параметров в еепром
 void eeprom_write()
 {
  //Пишем параметры из подменю 1(целочисленные)(в еепроме 1,2,3,4,5,6,7(8,9 в резерве))
  for (int i=1; i <= 7; i++)
   {
    EEPROM.write(i, param1[i]);
   }
  //Пишем параметры из подменю 2(температурные)(в еепроме 10-13,14-17)
  for (int i=1; i <= 2; i++)
   {
    EEFW(4*i+6, param2[i]);
   } 
  //Пишем параметры из подменю 3(поправки)(в еепроме 18-21,22-25,26-29,30-33,34-37,38-41,42-45,46-49,50-53,54-57,58-61,62-65,66-69)
  for (int i=1; i <= 13; i++)
   {
    EEFW(4*i+14, param3[i]);
   } 
 }

//Функция чтения из еепрома в переменные
void eeprom_read()
 {
  //Читаем параметры из подменю 1(целочисленные)(в еепроме 1,2,3,4,5,6,7)
  for (int i=1; i <= 7; i++)
   {
    param1[i] = EEPROM.read(i);
   }
  //Читаем параметры из подменю 2(температурные)(в еепроме 10-13,14-17)
  for (int i=1; i <= 2; i++)
   {
    param2[i] = EEFR(4*i+6);
   }
  //Читаем параметры из подменю 3(поправки)(в еепроме 18-21,22-25,26-29,30-33,34-37,38-41,42-45,46-49,50-53,54-57,58-61,62-65,66-69)
  for (int i=1; i <= 13; i++)
   {
    param3[i] = EEFR(4*i+14);
   }   
 }
 
//Процедура записи в еепром числа с плавающей точкой
void EEFW(int addr, double val) 
 { 
  byte *x = (byte *)&val;
  for(byte i = 0; i < 4; i++) EEPROM.write(i+addr, x[i]);
 }
       
//Процедура чтения из еепром числа с плавающей точкой
double EEFR(int addr) // чтение из ЕЕПРОМ
 {   
  byte x[4];
  for(byte i = 0; i < 4; i++) x[i] = EEPROM.read(i+addr);
  double *y = (double *)&x;
  return y[0];
 } 
